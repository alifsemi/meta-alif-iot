## conf/layer.conf
```bitbake
# We have a conf and classes directory, add to BBPATH
BBPATH .= ":${LAYERDIR}"

# We have recipes-* directories, add to BBFILES
BBFILES += "${LAYERDIR}/recipes-*/*/*.bb \
            ${LAYERDIR}/recipes-*/*/*.bbappend"

BBFILE_COLLECTIONS += "meta-alif-iot"
BBFILE_PATTERN_meta-alif-iot = "^${LAYERDIR}/"
BBFILE_PRIORITY_meta-alif-iot = "6"

LAYERDEPENDS_meta-alif-iot = "core"
LAYERSERIES_COMPAT_meta-alif-iot = "zeus"
```
